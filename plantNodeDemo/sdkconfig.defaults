## plantNodeDemo/sdkconfig.defaults
```kconfig
# ESP-IDF Configuration Defaults for ESP32-C6

# WiFi Configuration
CONFIG_ESP32_WIFI_STATIC_RX_BUFFER_NUM=10
CONFIG_ESP32_WIFI_DYNAMIC_RX_BUFFER_NUM=32
CONFIG_ESP32_WIFI_STATIC_TX_BUFFER_NUM=0
CONFIG_ESP32_WIFI_DYNAMIC_TX_BUFFER_NUM=32

# FreeRTOS Configuration
CONFIG_FREERTOS_UNICORE=n
CONFIG_FREERTOS_HZ=1000

# HTTP Configuration
CONFIG_ESP_HTTP_CLIENT_ENABLE_HTTPS=y

# NVS Configuration
CONFIG_NVS_ENCRYPTION=n

# Log Configuration
CONFIG_LOG_DEFAULT_LEVEL_INFO=y
CONFIG_LOG_MAXIMUM_LEVEL_INFO=y

# Serial Configuration
CONFIG_ESP_CONSOLE_UART_DEFAULT=y
CONFIG_ESP_CONSOLE_UART_BAUDRATE_115200=y

# Networking
CONFIG_LWIP_SO_REUSE=y
CONFIG_LWIP_SO_REUSE_RXTOALL=y
```
